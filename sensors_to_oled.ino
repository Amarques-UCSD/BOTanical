#include <Arduino.h>
#include <SPI.h>
#include <Wire.h>
#include <Adafruit_GFX.h>
#include <Adafruit_SSD1306.h>
#include <Adafruit_Sensor.h>
#include <Adafruit_BME280.h>


#define LED 2 // the blue LED pin
#define LIGHTSENSORPIN 39 //Ambient light sensor reading
#define SOILPIN 36  //Soil moisture sensor reading
#define WATERPOWER 17  //Water level sensor VCC
#define WATERPIN 34  //Water level sensor reading
#define BUTTON1 35
#define BUTTON2 32
#define BUTTON3 15

// Declaration for an SSD1306 display connected to I2C (SDA, SCL pins)
#define SCREEN_WIDTH 128 // OLED display width, in pixels
#define SCREEN_HEIGHT 64 // OLED display height, in pixels
#define OLED_RESET     -1 // Reset pin # (or -1 if sharing Arduino reset pin)
#define SCREEN_ADDRESS 0x3C ///< See datasheet for Address; 0x3D for 128x64, 0x3C for 128x32
Adafruit_SSD1306 display(SCREEN_WIDTH, SCREEN_HEIGHT, &Wire, OLED_RESET);

// Create BME280 object
#define SEALEVELPRESSURE_HPA (1013.25)
Adafruit_BME280 bme; // I2C


static const unsigned char PROGMEM BOTanical_logo[] = {
  0xff, 0xff, 0xff, 0xff, 0xff, 0xff, 0xff, 0xff, 0xff, 0xff, 0xff, 0xff, 0xff, 0xff, 0xff, 0xff, 
	0xff, 0xff, 0xff, 0xff, 0xff, 0xff, 0xff, 0xff, 0xff, 0xff, 0xff, 0xff, 0xff, 0xff, 0xff, 0xff, 
	0xff, 0xff, 0xff, 0xff, 0xff, 0xff, 0xff, 0xff, 0xff, 0xff, 0xff, 0xff, 0xff, 0xff, 0xff, 0xff, 
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	0xff, 0xff, 0xff, 0xff, 0xff, 0xff, 0xff, 0xff, 0xff, 0xff, 0xff, 0xff, 0xff, 0xff, 0xff, 0xff
};


// variables for calculation
float cycle_length = 30; //30 * 2s delay = 1min cycle
float cur_cycle = 0;

float exp_light = 1000; // expected light over a cycle
float exp_moist = 1000; // threshold for moisture
float exp_temp = 1000; // average expected temperature
float exp_humid = 1000; // average expected humidity
float avg_light = 0;
float avg_moist = 0;
float avg_temp = 0;
float avg_humid = 0;
float past_light = exp_light; // so its not on at start
float past_moist = exp_moist;
float past_temp = exp_temp;
float past_humid = exp_humid;

int already_watered = LOW;

// variables for menu
int menu_sizes[] = {6,1,5,1,2,10,1,1,1,1,1,2,1,1,2};
int menu_pointer = 0;
int cur_state = 0;
int menu_len = menu_sizes[cur_state];
int pointer_blink = 0;

// variables for the buttons
int last1 = HIGH;
int cur1 = HIGH;
int last2 = HIGH;
int cur2 = HIGH;
int last3 = HIGH;
int cur3 = HIGH;

void setup() {  // put your setup code here, to run once:
  Serial.begin(115200);

  pinMode(LED, OUTPUT);   // configure pin as an OUTPUT
  pinMode(LIGHTSENSORPIN, INPUT);
  pinMode(SOILPIN, INPUT);
  pinMode(WATERPOWER, OUTPUT);
  pinMode(WATERPIN, INPUT);

  pinMode(BUTTON1, INPUT_PULLUP); // button 1 as internal pull-up resistor
  pinMode(BUTTON2, INPUT_PULLUP); // button 2 as internal pull-up resistor
  pinMode(BUTTON3, INPUT_PULLUP); // button 3 as internal pull-up resistor

  // following for oled
  // SSD1306_SWITCHCAPVCC = generate display voltage from 3.3V internally
  if(!display.begin(SSD1306_SWITCHCAPVCC, SCREEN_ADDRESS)) {
    Serial.println(F("SSD1306 allocation failed"));
    for(;;); // Don't proceed, loop forever
  }

  // Show initial display buffer contents on the screen --
  // change from Adafruit splash screen to BOTanical
  display.clearDisplay();
  display.drawBitmap(0, 0, BOTanical_logo, 128, 64, 1);
  display.display();
  delay(2000); // Pause for 2 seconds, let OLED boot up

  // Clear the buffer
  display.clearDisplay();

  // initiate bme280
/*  if (!bme.begin(0x77)) {
    Serial.println("Could not find a valid BME280 sensor, check wiring!");
    while (1);
  }*/
}

void loop() { // put your main code here, to run repeatedly:
  time_t now;
  char strftime_buf[64];
  struct tm timeinfo;

  time(&now);
  // Set time start to 00:00:00 Jan 1st, 1970
  setenv("TZ", "UTC-0", 1);
  tzset();
  localtime_r(&now, &timeinfo);
  strftime(strftime_buf, sizeof(strftime_buf), "%c", &timeinfo);
  //Serial.println(strftime_buf);

  // buttons will be LOW(0) or HIGH(1)
  cur1 = digitalRead(BUTTON1); 
  cur2 = digitalRead(BUTTON2);
  cur3 = digitalRead(BUTTON3);

  int pressed1 = LOW;
  int pressed2 = LOW;
  int pressed3 = LOW; 
  if(last1 == LOW && cur1 == HIGH) {
    pressed1 = HIGH;  // Button 1 was just pressed
    Serial.println("Button 1 pressed");
    
    if (menu_pointer == menu_len-1) {
      menu_pointer = 0;  // already at the bottom, go to top
    } else {
      menu_pointer++;
    }
  }
  if(last2 == LOW && cur2 == HIGH) {
    pressed2 = HIGH;  // Button 2 was just pressed
    Serial.println("Button 2 pressed");

    if (menu_pointer == 0) { 
      menu_pointer = menu_len-1;  // already at the top, go to bottom        
    } else {
      menu_pointer--;
    }
  }
  if(last3 == LOW && cur3 == HIGH) {
    pressed3 = HIGH;  // Button 3 was just pressed
    Serial.println("Button 3 pressed");

    change_menu();    
  } 
  last1 = cur1;
  last2 = cur2;
  last3 = cur3;


  //Read light level
  float light_reading = analogRead(LIGHTSENSORPIN);

  // Water level sensor
  digitalWrite(WATERPOWER, HIGH);  // turn the sensor ON
  delay(10);                      // wait 10 milliseconds
  float water_level = analogRead(WATERPIN); // read the analog value from sensor
  digitalWrite(WATERPOWER, LOW);   // turn the sensor OFF

  // Moisture sensor
  float moist_reading = analogRead(SOILPIN); // read the analog value from sensor

  // BME280 readings (works for both I2C and SPI)
/*  float temp_reading = bme.readTemperature();
  float press_reading = bme.readPressure();
  float height_reading = bme.readAltitude(SEALEVELPRESSURE_HPA);
  float humid_reading = bme.readHumidity();*/


  // Calculate averages
  avg_light += light_reading/cycle_length;
  avg_moist += moist_reading/cycle_length;
  //avg_temp += temp_reading/cycle_length;
  //avg_humid += humid_reading/cycle_length;  
  cur_cycle++;  // increment cycle as calculations are done


  //  Code for OLED
  display.clearDisplay();
  display.setTextSize(1);
  display.setTextColor(WHITE);
  
  // show time
  display.setCursor(75, 0);  
  strftime_buf[19] = '\0';
  display.println(&strftime_buf[11]);
  display.drawRect(73, -10, 100, 20, WHITE);

  switch(cur_state) {
    case 0:
      menu_display(); 
      break;
    case 1:
      overview_display(light_reading);
      break;   
    case 2:
      sensors_display();
      break;      
    case 3:
      notifications_display();
      break;      
    case 4:
      water_display();
      break;         
    case 5:
      plant_display();
      break;      
    case 6:
      credit_display();
      break;      
    case 7:
      light_data(light_reading);
      break;           
    case 8:
      moist_data(moist_reading);
      break;      
    case 9:
      temp_data(light_reading); // need to change when bme connected
      break;      
    case 10:
      humid_data(light_reading);
      break;       
    default:  // show logo and back to menu if not coded or an error occurs
      display.drawBitmap(0, 0, BOTanical_logo, 128, 64, 1);
      cur_state = 0;
      break;             
  }
  
  menu_len = menu_sizes[cur_state];
  Serial.printf("State = %d , menu_size = %d , pointer = %d\n", cur_state, menu_len, menu_pointer); // for tracking the state

  if (past_light < exp_light && avg_light < exp_light * cur_cycle/cycle_length) {  // less light then currently expected
    digitalWrite(LED, HIGH);
  } else {
    digitalWrite(LED, LOW);
    
    /*  // Circle with exclamation mark
    display.println("No Light detected!");
    display.fillCircle(64, 40, 16, WHITE);
    display.fillCircle(64, 40, 13, BLACK);
    display.fillRect(62, 30, 4, 10, WHITE);
    display.fillCircle(64, 45, 3, WHITE);*/
  }
  display.display();

  if (cur_cycle == cycle_length) { // reset cycle
    cur_cycle = 0;
    
    past_light = avg_light;
    past_moist = avg_moist;
    past_temp = avg_temp;
    past_humid = avg_humid;
    avg_light = 0;
    avg_moist = 0;
    avg_temp = 0;
    avg_humid = 0;
  }

  delay(1000); // set up a delay of 1s
}

void menu_display(){
  // show menu
  char* menu_text[menu_len] = {"Overview", "Sensor Readings", "Notifications", "Already Watered", "Select Plant", "Credits" };
  for (int i = 0; i < menu_len; i++) {
    display.setCursor(15, 5+10*i);
    display.println(menu_text[i]);      
  }    
  // Draw pointer
  if (pointer_blink == 0) {
    display.drawCircle(7, 8+10*menu_pointer, 2, WHITE);
    pointer_blink = 1;
  } else {
    display.fillCircle(7, 8+10*menu_pointer, 2, WHITE);
    pointer_blink = 0;
  }  
}

void overview_display(float light_reading){
  // Display static text
  display.setCursor(0, 20);
  display.print("Light value = ");
  display.println((int) light_reading);
  display.print("Avg value = ");
  display.println((int) avg_light);
  display.print("Cycle = ");
  display.println((int) cur_cycle);
  display.print("C_expected = ");
  display.println(exp_light  * cur_cycle/cycle_length);
}

void sensors_display() {
  // Display static text
  display.setCursor(0, 0);
  display.println("Options:");

  // show menu
  char* menu_text[menu_len] = {"Light Sensor", "Moisture Sensor", "Temperature sensor", "Humidity sensor", "Back"};
  for (int i = 0; i < menu_len; i++) {
    display.setCursor(15, 15+10*i);
    display.println(menu_text[i]);      
  }    
  // Draw pointer
  if (pointer_blink == 0) {
    display.drawCircle(7, 18+10*menu_pointer, 2, WHITE);
    pointer_blink = 1;
  } else {
    display.fillCircle(7, 18+10*menu_pointer, 2, WHITE);
    pointer_blink = 0;
  }  
}

void notifications_display(){
  // Display static text
  display.setCursor(0, 20);
  display.println("Notifications:");
}
 
void water_display() {
  // Display static text
  display.setCursor(0, 17);
  display.println("Have you watered the plant today?");
  display.setCursor(15, 40);
  display.println("Yes (skip cycle)");
  display.setCursor(15, 50);
  display.println("No");
  
  // Draw pointer
  if (pointer_blink == 0) {
    display.drawCircle(7, 43+10*menu_pointer, 2, WHITE);
    pointer_blink = 1;
  } else {
    display.fillCircle(7, 43+10*menu_pointer, 2, WHITE);
    pointer_blink = 0;
  } 
}
  
void plant_display(){
  // Display static text
  display.setCursor(0, 0);
  display.println("Choose from:");
  display.drawRect(1, 15, 126, 48, WHITE);
  
  // show scrolling menu
  char* menu_text[menu_len] = {"Back", "Plant 1", "Plant 2", "Plant 3", "Plant 4", "Plant 5", "Plant 6", "Plant 7", "Plant 8", "Plant 9"};
  for (int i = 0; i < 4; i++) { 
    display.setCursor(15, 20+10*i);
    display.println(menu_text[(menu_len + menu_pointer+i-1) % menu_len]);      
  }    
  // Draw pointer
  if (pointer_blink == 0) {
    display.drawCircle(7, 33, 2, WHITE);
    pointer_blink = 1;
  } else {
    display.fillCircle(7, 33, 2, WHITE);
    pointer_blink = 0;
  }  

  // Draw scrolling bar
  for (int i = 0; i < 8; i++) {
    display.drawPixel(120, 22+i*5, WHITE);
  }
  display.fillRect(119, 17+(8*menu_pointer*5)/menu_len, 4, 8, WHITE);
}

void credit_display() {
  // Display static text
  display.setCursor(0, 15);
  display.println("Made by:\n  Alexandre Marques\n  Snir Kinog\n  Sahil Singh");
  display.setCursor(0, 52);  
  display.println("ECE 196 WI23");
}      

void light_data(float light_reading) {
  // Display static text
  display.setCursor(0, 20);
  display.print("Light value = ");
  display.println((int) light_reading);
  display.print("Avg value = ");
  display.println((int) avg_light);
  display.print("Cycle = ");
  display.println((int) cur_cycle);
  display.print("C_expected = ");
  display.println(exp_light  * cur_cycle/cycle_length);  
}

void moist_data(float moist_reading) {
  // Display static text
  display.setCursor(0, 20);
  display.print("Moisture value = ");
  display.println((int) moist_reading);
  display.print("Avg value = ");
  display.println((int) avg_moist);
  display.print("Cycle = ");
  display.println((int) cur_cycle);
  display.print("C_expected = ");
  display.println(exp_moist  * cur_cycle/cycle_length);  
}

void temp_data(float temp_reading) {
  // Display static text
  display.setCursor(0, 20);
  display.print("Temperature value = ");
  display.println((int) temp_reading);
  display.print("Avg value = ");
  display.println((int) avg_temp);
  display.print("Cycle = ");
  display.println((int) cur_cycle);
  display.print("C_expected = ");
  display.println(exp_temp  * cur_cycle/cycle_length);  
}

void humid_data(float humid_reading) {
  // Display static text
  display.setCursor(0, 20);
  display.print("Humidity value = ");
  display.println((int) humid_reading);
  display.print("Avg value = ");
  display.println((int) avg_humid);
  display.print("Cycle = ");
  display.println((int) cur_cycle);
  display.print("C_expected = ");
  display.println(exp_humid  * cur_cycle/cycle_length);  
}

void change_menu() {
  switch(cur_state) {
    case 0:
      cur_state = 1+menu_pointer;
      break;
    case 1:
      cur_state = 0;
      break;
    case 2:
      if (menu_pointer == 4) {
        cur_state = 0;
      } else {
        cur_state = 7+menu_pointer;        
      }
      break;
    case 3:
      cur_state = 11;  
    case 4:
      cur_state = 0;
      if (menu_pointer == 0) {
        already_watered = HIGH;
      } else {
        already_watered = LOW;
      }
      break;
    case 6:
      cur_state = -1;
      break;
    case 7:
    case 8:
    case 9:
    case 10:
      cur_state = 2;
      break;
    default:  // go to invalid state
      cur_state = -1;
      break;             
  }

  menu_pointer = 0;
}
